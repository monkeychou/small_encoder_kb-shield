## west.yml
```yaml
manifest:
  remotes:
    - name: zmk
      url-base: https://github.com/zmkfirmware
      - name: monkeychou
      url-base: https://github.com/monkeychou
      
  projects:
    # Together with the above defined remote, this refers to a module located at
    # https://github.com/remote-name/repository-name
    - name: zmk
      remote: zmk
      # This points to a west manifest file in the remote module for further imports
      import: app/west.yml
    - name: small_encoder_kb   # 新增 module
      remote: monkeychou
      revision: main
      url: https://github.com/monkeychou/small_encoder_kb-shield
```
